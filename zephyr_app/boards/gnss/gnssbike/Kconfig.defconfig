## zephyr_app/boards/gnss/gnssbike/Kconfig.defconfig
```kconfig
# SPDX-License-Identifier: Apache-2.0

if BOARD_GNSSBIKE_NRF54LM20A_CPUAPP

config HW_STACK_PROTECTION
	default ARCH_HAS_STACK_PROTECTION

endif # BOARD_GNSSBIKE_NRF54LM20A_CPUAPP
```

## zephyr_app/boards/gnss/gnssbike/Kconfig.gnssbike
```kconfig
# SPDX-License-Identifier: Apache-2.0

config BOARD_GNSSBIKE
	select SOC_NRF54LM20A_CPUAPP if BOARD_GNSSBIKE_NRF54LM20A_CPUAPP
```

## zephyr_app/boards/gnss/gnssbike/board.yml
```yaml
board:
  name: gnssbike
  full_name: GNSS Bike Computer (custom board)
  vendor: gnss
  socs:
  - name: nrf54lm20a
```

## zephyr_app/modules/gnss_drivers/Kconfig
```kconfig
# SPDX-License-Identifier: Apache-2.0

menu "GNSS bike computer drivers"

rsource "drivers/display/Kconfig"
rsource "drivers/fuel_gauge/Kconfig"
rsource "drivers/charger/Kconfig"

endmenu
```

## zephyr_app/modules/gnss_drivers/drivers/charger/Kconfig
```kconfig
# SPDX-License-Identifier: Apache-2.0

config GNSS_CHARGER_AEM10900
	bool "AEM10900 solar charger (e-peas,aem10900)"
	default y
	depends on DT_HAS_E_PEAS_AEM10900_ENABLED
	depends on CHARGER
	select I2C
	help
	  e-peas AEM10900 solar charger by the Zephyr charger API: the I2C
	  thresholds with the board on, the pins back before the ship
	  mode, and the average power monitor.

if GNSS_CHARGER_AEM10900

module = GNSS_CHARGER_AEM10900
module-str = aem10900
source "subsys/logging/Kconfig.template.log_config"

endif
```

## zephyr_app/modules/gnss_drivers/drivers/display/Kconfig
```kconfig
# SPDX-License-Identifier: Apache-2.0

config MEMLCD
	bool "Memory-in-pixel displays (JDI LPM027M128B/C, Sharp LS027B7DH01)"
	default y
	depends on DT_HAS_JDI_LPM027M128B_ENABLED || DT_HAS_JDI_LPM027M128C_ENABLED || \
		   DT_HAS_SHARP_LS027B7DH01_ENABLED
	depends on DISPLAY
	select SPI
	select GPIO
	help
	  Driver of the 2.7" memory-in-pixel panels of the GNSS bike computer:
	  the JDI LPM027M128B and LPM027M128C in 3 bits (8 colours) and the
	  Sharp LS027B7DH01 in 1 bit, with rotation to portrait, RGB565 input
	  quantised to the panel colours, only the changed lines sent at the
	  end of each frame, and COM inversion by the EXTCOMIN pin or by the
	  serial VCOM bit.

if MEMLCD

module = MEMLCD
module-str = memlcd
source "subsys/logging/Kconfig.template.log_config"

endif
```

## zephyr_app/modules/gnss_drivers/drivers/fuel_gauge/Kconfig
```kconfig
# SPDX-License-Identifier: Apache-2.0

config GNSS_FUEL_GAUGE_MAX17262
	bool "MAX17262 fuel gauge (adi,max17262)"
	default y
	depends on DT_HAS_ADI_MAX17262_ENABLED
	depends on FUEL_GAUGE
	select I2C
	help
	  MAX17262 fuel gauge by the Zephyr fuel gauge API, with the
	  ModelGauge m5 EZ configuration and the register units of its
	  datasheet (the driver of the Zephyr tree, maxim,max17262, gets
	  them wrong).

if GNSS_FUEL_GAUGE_MAX17262

module = GNSS_FUEL_GAUGE_MAX17262
module-str = max17262
source "subsys/logging/Kconfig.template.log_config"

endif
```

## zephyr_app/modules/gnss_drivers/drivers/gnss/Kconfig
```kconfig
# SPDX-License-Identifier: Apache-2.0

config GNSS_UBLOX_M10
	bool "u-blox M10 and F10 GNSS receivers by UBX"
	default y
	depends on DT_HAS_U_BLOX_MAX_M10_ENABLED || DT_HAS_U_BLOX_MAX_F10_ENABLED
	depends on GNSS
	select MODEM_MODULES
	select MODEM_UBX
	select MODEM_BACKEND_UART
	select MODEM_DEDICATED_WORKQUEUE
	select UART_INTERRUPT_DRIVEN if !UART_ASYNC_API
	help
	  u-blox MAX-M10N ("u-blox,max-m10") and MAX-F10S ("u-blox,max-f10")
	  on a UART, with the configuration interface (UBX-CFG-VALSET), one
	  UBX-NAV-PVT per epoch, UBX-NAV-SAT for the sky plot and the software
	  standby by UBX-RXM-PMREQ. The M10 adds the LEAP power mode; the F10
	  receives L1 and L5 at the same time and has no CFG-PM group. The
	  Zephyr of the NCS has no driver for either: the M8 one speaks the
	  legacy UBX-CFG messages, which neither part accepts.

if GNSS_UBLOX_M10

config GNSS_UBLOX_M10_SATELLITES
	int "Satellites of the sky plot"
	default 32
	range 1 64
	depends on GNSS_SATELLITES
	help
	  How many satellites of a UBX-NAV-SAT message the driver keeps. Each
	  one takes 8 bytes in the published array and 8 more while parsing.

module = GNSS_UBLOX_M10
module-str = ublox_m10
source "subsys/logging/Kconfig.template.log_config"

endif
```

## zephyr_app/modules/gnss_drivers/dts/bindings/charger/e-peas,aem10900.yaml
```yaml
# SPDX-License-Identifier: Apache-2.0

description: |
  e-peas AEM10900 solar energy harvester and battery charger with MPPT,
  driven by the Zephyr charger API. The configuration pins of the board set
  the MPPT (80 % of the open-circuit voltage), the thresholds (charge to
  3.90 V, cut at 3.01 V) and the temperature range; with the board on, the
  driver switches to the I2C configuration to charge up to charge-voltage-mv
  and to read the average power monitor (APM). Keep-alive must be on
  (KEEP_ALIVE pin high) so the I2C configuration survives while the 3V0 rail
  is off.

compatible: "e-peas,aem10900"

include: i2c-device.yaml

properties:
  charge-voltage-mv:
    type: int
    default: 4050
    description: |
      Charge threshold (VOVCH) with the board on, in 56.25 mV steps from
      2.70 V to 4.78 V; docs/14 asks about 4.05 V.

  discharge-voltage-mv:
    type: int
    default: 3040
    description: |
      Discharge threshold (VOVDIS), in 56.25 mV steps; 3040 is the register
      reset value, the nearest step to the 3.01 V of the pins.

  pins-charge-voltage-mv:
    type: int
    default: 3900
    description: |
      Charge threshold the configuration pins (STO_CFG) select, reported
      while the pins are in force.

  apm-scale-pj:
    type: int
    default: 0
    description: |
      Energy of one APM unit in picojoules: the theta x L product of the
      datasheet (section 9.13), which e-peas gives for each application.
      0 means not calibrated: the driver then reports no power, only that
      energy flows.
```

## zephyr_app/modules/gnss_drivers/dts/bindings/display/jdi,lpm027m128b.yaml
```yaml
# SPDX-License-Identifier: Apache-2.0

description: |
  JDI LPM027M128B 2.7" memory-in-pixel LCD, 400 x 240, 8 colours (1 bit per
  channel), reflective, without a light of its own: the panel of the new
  board. SPI with the most significant bit first and the chip select active
  high (LPM027M128B specification, section 6): 6 mode bits (M0 update, M1
  COM, M2 all clear, M3-M4 data width), a 10-bit line address, 400 pixels of
  3 bits in red, green, blue order (low is black), and 16 clocks after the
  last line. Driven in 3-bit mode. Signals at the level of its VDD (3.0 V
  typical, high above VDD - 0.1 V). DISP low shows solid black and keeps
  the pixel memory.

compatible: "jdi,lpm027m128b"

include: memlcd-common.yaml
```

## zephyr_app/modules/gnss_drivers/dts/bindings/display/jdi,lpm027m128c.yaml
```yaml
# SPDX-License-Identifier: Apache-2.0

description: |
  JDI LPM027M128C 2.7" memory-in-pixel LCD, 400 x 240, 8 colours: the
  LPM027M128B with a light. Same protocol as jdi,lpm027m128b (LPM027M128B
  specification, section 6), driven in 3-bit mode.

compatible: "jdi,lpm027m128c"

include: memlcd-common.yaml
```

## zephyr_app/modules/gnss_drivers/dts/bindings/display/memlcd-common.yaml
```yaml
# SPDX-License-Identifier: Apache-2.0
#
# Common properties of the 2.7" memory-in-pixel panels of the GNSS bike
# computer (JDI LPM027M128B and C, Sharp LS027B7DH01). width and height are the
# panel in its native orientation: 400 pixels per line, 240 lines.

include: [spi-device.yaml, display-controller.yaml]

properties:
  rotation:
    type: int
    default: 90
    enum: [0, 90, 180, 270]
    description: |
      Rotation of what the application draws. 90 is the portrait of the
      myStravaB V3 and of the new board: a point (x, y) of the 240 x 400
      picture goes to column y of line 239 - x of the panel, as the legacy
      drawPixel() with setRotation(3).

  disp-gpios:
    type: phandle-array
    description: |
      DISP pin: high shows the picture. Without it, the pin is tied high on
      the board (myStravaB V3).

  extcomin-gpios:
    type: phandle-array
    description: |
      EXTCOMIN pin, with EXTMODE tied high: the COM inverts on each rising
      edge. Without it, EXTMODE is tied low and the driver inverts the COM by
      the serial VCOM bit (M1), as the legacy.

  extcomin-frequency:
    type: int
    default: 1
    description: |
      COM inversions per second at start: rising edges of EXTCOMIN, or
      changes of the serial VCOM bit. The Sharp takes 1 to 20 and the JDI
      1 to 140 (the COM runs at half of it). memlcd_set_com_hz() changes it:
      about 120 on the JDI with the light on, for the COM near the 60 Hz of
      its transmissive mode.

  power-gpios:
    type: phandle-array
    description: |
      Enable of the panel supply, when the board switches it (the 5 V
      REG710 of the Sharp on the new board).
```

## zephyr_app/modules/gnss_drivers/dts/bindings/display/sharp,ls027b7dh01.yaml
```yaml
# SPDX-License-Identifier: Apache-2.0

description: |
  Sharp LS027B7DH01 (and LS027B7DH01A) 2.7" memory LCD, 400 x 240, 1 bit per
  pixel, SPI with the least significant bit first and the chip select active
  high: a mode byte (M0 update, M1 VCOM, M2 all clear), then for each line
  its number, 50 bytes of pixels (1 is white) and a dummy byte, and a last
  dummy byte. The panel of the myStravaB V3 and of the shopping list of the
  new board.

compatible: "sharp,ls027b7dh01"

include: memlcd-common.yaml
```

## zephyr_app/modules/gnss_drivers/dts/bindings/fuel-gauge/adi,max17262.yaml
```yaml
# SPDX-License-Identifier: Apache-2.0

description: |
  Analog Devices (formerly Maxim) MAX17262 1-cell fuel gauge with ModelGauge
  m5 EZ and internal current sensing, driven by the Zephyr fuel gauge API.
  The EZ configuration below is written after each power-on reset of the
  gauge, in the register units of the datasheet (Table 2). A separate
  compatible from the Zephyr tree's maxim,max17262 (sensor API), whose
  configuration misses those units.

compatible: "adi,max17262"

include: [fuel-gauge.yaml, i2c-device.yaml]

properties:
  design-capacity-mah:
    type: int
    required: true
    description: Label capacity of the cell (DesignCap, 0.5 mAh steps).

  charge-term-current-ma:
    type: int
    required: true
    description: |
      Termination current of the charger (IChgTerm, 156.25 uA steps): the
      datasheet asks for the exact end-of-charge current of the application.

  empty-voltage-mv:
    type: int
    default: 3300
    description: |
      Empty voltage under load (VEmpty.VE, 10 mV steps): the gauge declares
      0 % there. 3300 is the reset value of the gauge.

  recovery-voltage-mv:
    type: int
    default: 3880
    description: |
      Voltage that clears the empty detection (VEmpty.VR, 40 mV steps);
      3880 is the reset value and the datasheet's recommendation.

  charge-voltage-mv:
    type: int
    default: 4200
    description: |
      Charge termination voltage; above 4250 mV the model uses ModelCfg.VChg.

  thermistor:
    type: boolean
    description: |
      A thermistor on the TH pin. Without it (TH tied to BATT) the driver
      clears Config.ETHRM and the temperature comes from the die.
```

## zephyr_app/modules/gnss_drivers/dts/bindings/gnss/u-blox,max-f10.yaml
```yaml
# Copyright (c) 2026 Luiz Guilherme Ito
# SPDX-License-Identifier: Apache-2.0

description: |
  u-blox F10 dual-band GNSS receiver on a UART, by the UBX protocol (MAX-F10S
  of the new board). Same driver as the "u-blox,max-m10": the frames and the
  configuration keys of the UART, the rate, the dynamic model and the message
  output are the same on the two firmwares.

  What differs, and why this is a compatible of its own:

  - The F10 receives L1 and L5 at the same time and cannot do one band only:
    "Single-band operation is not supported. Both L1 and L5 signals must be
    enabled or disabled" (MAX-F10S data sheet UBXDOC-963802114-12732 R03,
    section 1.3). There is nothing to configure and no band property here.
  - The F10 has no CFG-PM group (F10 SPG 6.00 interface description
    UBX-23002975 R02, section 4.8): no LEAP, no ON/OFF power save. The
    receiver tracks at full power, 16 mA at VCC plus 3 mA at V_IO with a 3.0 V
    supply (data sheet, table 15), and what saves energy is the software
    standby by UBX-RXM-PMREQ, which the driver still has.
  - It adds NavIC, off by default in the receiver.
  - GPS L5 is enabled in the firmware but the satellites still broadcast as
    unhealthy, so the solution leaves them out until the signal becomes
    operational; the dual-band gain today comes from Galileo E5a, BeiDou B2a
    and QZSS L5 (data sheet, section 1.1).

  Example:

    &uart21 {
        status = "okay";
        current-speed = <38400>;

        gnss: gnss@0 {
            compatible = "u-blox,max-f10";
            fix-rate-ms = <1000>;
            dynamic-model = "portable";
        };
    };

compatible: "u-blox,max-f10"

include: uart-device.yaml

properties:
  fix-rate-ms:
    type: int
    default: 1000
    description: |
      Interval between navigation epochs, in milliseconds (CFG-RATE-MEAS).
      The default is the 1 Hz of the legacy. The receiver takes 25 to
      65535 ms, and reaches 10 Hz in the single-GNSS configurations.

  dynamic-model:
    type: string
    default: "portable"
    description: |
      Dynamic platform model (CFG-NAVSPG-DYNMODEL). "portable" is what u-blox
      recommends for most uses and what a bicycle needs: "bike" in the
      receiver is a motorbike, and "pedestrian" limits speed and altitude
      changes below what a descent reaches.
    enum:
      - "portable"
      - "stationary"
      - "pedestrian"
      - "automotive"
      - "sea"
      - "airborne_1g"
      - "airborne_2g"
      - "airborne_4g"
      - "wrist"
      - "bike"

  navic:
    type: boolean
    description: |
      Also receive NavIC L5 (CFG-SIGNAL-NAVIC_ENA), which the receiver leaves
      off. It only covers India and the region around it; elsewhere it costs
      channels for nothing.

  satellites-rate:
    type: int
    default: 1
    description: |
      Epochs between two UBX-NAV-SAT messages, for the sky plot; 0 turns the
      message off. Only used when CONFIG_GNSS_SATELLITES is on.

  timepulse-enable:
    type: boolean
    description: |
      Keep the time pulse of the receiver on (CFG-TP-TP1_ENA).

  reset-gpios:
    type: phandle-array
    description: |
      RESET_N of the receiver, active low, driven open drain. The driver only
      configures it; a reset clears the backup memory of the receiver.

  vcc-supply:
    type: phandle
    description: |
      Regulator of the VCC and V_IO rails of the receiver (BUCK1 of the
      nPM1300 on the new board). With it, the driver cuts the rail after the
      software standby, which leaves the receiver in hardware backup on
      V_BCKP, and turns it back on to wake up.
```
